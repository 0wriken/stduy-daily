#include "pwm_out.h"
u32 inter7;
u32 a=1;
u32 flag=0;

/***********************************************************************************************
* 函数功能：呼吸灯GPIO口初始化
* 函数形参: None
* 函数返回值: None
* 备注: None
* 作者: wriken
* 时间: 2019-08-15
* 修改作者: None
* 修改时间: None
***********/
void pwm_led_init()
{
		RCC->AHB1ENR|=(0x1<<0); //打开时钟使能
		GPIOA->MODER&=~(0x3<<2*6); //清除模式位
		GPIOA->MODER|=(0x2<<2*6);  //PA6为复用功能
		GPIOA->OTYPER&=~(0x1<<6);  //输出类型为推娩
		GPIOA->PUPDR&=~(0X3<<2*6); //无上下拉
		GPIOA->OSPEEDR&=~(0X3<<2*6); //速度为2M
		GPIOA->AFR[0]&=~(0XF<<4*6);		//复用功能为定时
		GPIOA->AFR[0]|=(0X2<<4*6);//tim3
}

/***********************************************************************************************
* 函数功能：呼吸灯的基本定时初始化
* 函数形参: None
* 函数返回值: None
* 备注: None
* 作者: wriken
* 时间: 2019-08-14
* 修改作者: None
* 修改时间: None
***********/
void pwm_out_init()
{
		RCC->APB1ENR|=(0X1<<1);  //打开时钟使能
		TIM3->SMCR&=~(0X7<<0);		//清除
		TIM3->SMCR&=~(0X1<<14);//时钟源选择系统时钟源，禁止外部时钟模式 2
		TIM3->PSC=83;//分频器1HZ
		TIM3->ARR=1000-1;//定时时间为1毫秒
		TIM3->CNT=0;    //清除计数数值
		TIM3->EGR|=(0X1<<0);  //打开计数器使能
		TIM3->SR&=~(0X1<<0);	//清除标志位
		TIM3->CR1=0;					//清除
		TIM3->DIER|=(0X1<<0);	//打开中断使能
		TIM3->CR1|=(0X1<<0);	//打开定时使能
		TIM3->CR1&=~(0x1<<1); //配置1次UG位
		TIM3->CR1&=~(0X1<<3);  //定时时间到不会停止
		NVIC_SetPriorityGrouping(7-2);//抢占位
		inter7=NVIC_EncodePriority(7-2,0, 0);//抢占与响应优先级
		NVIC_SetPriority(TIM3_IRQn, inter7);//中断类型
		NVIC_EnableIRQ(TIM3_IRQn);	 //打开该类型中断使能
}

/***********************************************************************************************
* 函数功能：呼吸灯的定时中断服务函数
* 函数形参: None
* 函数返回值: None
* 备注: None
* 作者: wriken
* 时间: 2019-08-15
* 修改作者: None
* 修改时间: None
***********/
void TIM3_IRQHandler ()
{	
	if(TIM3->SR&(0X1<<0)) //判断定时中断标志位
	{
		if(a<1000&&flag==0)   //亮度最亮到最暗
		{
			TIM3->SR&=~(0X1<<0); //定时标志位清0
			TIM3->CCR1=a-1;//占空比	
			a++;
			flag=0;
			if(a==1000)
				flag=1;
		}
		if(a<1001&&flag==1)   //亮度由最暗到最亮
		{
			TIM3->SR&=~(0X1<<0);
			TIM3->CCR1=a-1;//占空比
			a--;
			flag=1;
			if(a==0)
				flag=0;  //亮灭标志位
		}

		TIM3->CCMR1&=~(0XFF<<0);

		TIM3->CCMR1|=(0X6<<4);//PWM当计数值小于寄存器的值时，输出有效状态

		TIM3->CCER&=~(0XF<<0);

		TIM3->CCER|=(0X1<<0);//使能PWM的输出z状态
		
	}
}



